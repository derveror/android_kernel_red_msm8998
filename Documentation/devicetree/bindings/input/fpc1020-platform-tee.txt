## Documentation/devicetree/bindings/input/fpc1020-platform-tee.txt
```
FPC1020 platform/TEE fingerprint resource driver

The driver controls the electrical resources used by an FPC1020 sensor. It
does not transfer fingerprint data; those transactions are owned by the TEE.

Required properties:
- compatible: must be "fpc,fpc1020"
- fpc,gpio_irq: GPIO connected to the sensor interrupt output
- fpc,gpio_rst: GPIO connected to the active-low sensor reset input
- pinctrl-names: must contain "fpc1020_reset_reset",
  "fpc1020_reset_active" and "fpc1020_irq_active"
- pinctrl-0, pinctrl-1, pinctrl-2: phandles for those named states
- vcc_spi-supply: SPI-interface supply
- vdd_ana-supply: sensor analog supply
- vdd_io-supply: sensor I/O supply

Optional properties:
- fpc,enable-wakeup: mark the IRQ as a no-suspend wake source
- fpc,enable-on-boot: prepare regulators and reset at probe time

Example:

	fingerprint {
		compatible = "fpc,fpc1020";
		fpc,gpio_irq = <&tlmm 121 0>;
		fpc,gpio_rst = <&tlmm 32 0>;
		pinctrl-names = "fpc1020_reset_reset",
			"fpc1020_reset_active", "fpc1020_irq_active";
		pinctrl-0 = <&fpc_reset_low>;
		pinctrl-1 = <&fpc_reset_high>;
		pinctrl-2 = <&fpc_irq_active>;
		vcc_spi-supply = <&pm8998_s4>;
		vdd_ana-supply = <&pm8998_l18>;
		vdd_io-supply = <&pm8998_l18>;
		fpc,enable-on-boot;
	};
```

## Documentation/devicetree/bindings/video/backlight/lm36923h.txt
```
TI LM36923H backlight controller on RED Hydrogen One

Required properties:
- compatible: must be "ti,lm36923h"
- reg: I2C address of the primary controller; must be 0x36
- hwen-gpio: GPIO driving the active-high hardware-enable input

Optional properties:
- current-limitation: maximum LED current in mA, in the range 1 through 25
- dual-3d-bkl: the RED dual-backlight assembly is fitted. The driver mirrors
  initialization, enable and brightness writes to the stock secondary address
  0x37. Probe fails if either controller cannot be initialized.

Example:

	lm36923h@36 {
		compatible = "ti,lm36923h";
		reg = <0x36>;
		hwen-gpio = <&tlmm 128 0>;
		current-limitation = <14>;
		dual-3d-bkl;
	};
```

## drivers/input/fingerprint/Kconfig
```kconfig
menuconfig INPUT_FINGERPRINT
	bool "Fingerprint sensor support"
	depends on INPUT
	help
	  Say Y here to enable fingerprint sensor platform drivers.

if INPUT_FINGERPRINT

config INPUT_FPC_FINGERPRINT
	bool "FPC1020 platform/TEE resource driver"
	depends on OF && GPIOLIB && PINCTRL && REGULATOR
	help
	  Controls the GPIO, pinctrl, regulator and interrupt resources used by
	  an FPC1020 fingerprint sensor. Sensor transactions remain in the
	  trusted execution environment; this driver does not access sensor data.

endif
```

## drivers/input/touchscreen/cyttsp5/Kconfig
```kconfig
config TOUCHSCREEN_CYPRESS_CYTTSP5
	bool "Cypress TrueTouch Gen5 touchscreen"
	depends on I2C && OF
	select INPUT_MT
	help
	  Enable the Cypress TrueTouch Gen5 controller used by the JDI
	  production variant of the RED Hydrogen One.

	  The driver provides the I2C transport, protocol-B multitouch,
	  capacitive-button and proximity input paths described by the RED DT.

config TOUCHSCREEN_CYPRESS_CYTTSP5_DEVICETREE_SUPPORT
	bool
	default y if TOUCHSCREEN_CYPRESS_CYTTSP5

config TOUCHSCREEN_CYPRESS_CYTTSP5_I2C
	bool
	default y if TOUCHSCREEN_CYPRESS_CYTTSP5

config TOUCHSCREEN_CYPRESS_CYTTSP5_MT_B
	bool
	default y if TOUCHSCREEN_CYPRESS_CYTTSP5

config TOUCHSCREEN_CYPRESS_CYTTSP5_BUTTON
	bool
	default y if TOUCHSCREEN_CYPRESS_CYTTSP5

config TOUCHSCREEN_CYPRESS_CYTTSP5_PROXIMITY
	bool
	default y if TOUCHSCREEN_CYPRESS_CYTTSP5
```

## sound/soc/codecs/tfa9894/Kconfig
```kconfig
config SND_SOC_TFA9894
	tristate "NXP TFA9894 speaker amplifier"
	depends on I2C
	select REGMAP_I2C
	help
	  Enable support for the paired NXP TFA9894 smart amplifiers used
	  by the RED Hydrogen One.
```
