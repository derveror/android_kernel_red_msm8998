/*
 * Copyright (c) 2026, The LineageOS Project. All rights reserved.
 *
 * This program is free software; you can redistribute it and/or modify
 * it under the terms of the GNU General Public License version 2 and
 * only version 2 as published by the Free Software Foundation.
 */

/dts-v1/;

#include "msm8998-v2.1.dtsi"
#include "msm8998-mdss-panels.dtsi"
#include "msm8998-mtp.dtsi"
#include "msm8998-red-hydrogenone-common.dtsi"
#include "msm8998-red-hydrogenone-pvt.dtsi"
#include "msm8998-red-hydrogenone-panel-sim.dtsi"

/ {
	model = "Qualcomm Technologies, Inc. MSM8998 v2.1 MTP, CloudMinds redphone SIM PVT";
	compatible = "qcom,msm8998-mtp", "qcom,msm8998", "qcom,mtp";
	qcom,board-id = <8 0 1 0>;
	fih,hw-id = <4 4 0>;
	cm,display-id = <0x7f>;
};
